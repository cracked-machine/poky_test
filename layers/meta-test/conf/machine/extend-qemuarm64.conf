## layers/meta-test/conf/machine/extend-qemuarm64.conf
```bitbake
require conf/machine/qemuarm64.conf



MACHINEOVERRIDES = "extend-qemuarm64:qemuarm64"

PREFERRED_PROVIDER_virtual/kernel ?= "linux-yocto"
PREFERRED_VERSION_linux-yocto ?= "5.19%"

MACHINE_EXTRA_RRECOMMENDS = "kernel-modules devicetree"

EXTRA_IMAGEDEPENDS += "virtual/bootloader"
PREFERRED_PROVIDER_virtual/bootloader ?= "u-boot"
```

## layers/meta-test/conf/machine/extend-qemux86-64.conf
```bitbake
require conf/machine/qemux86-64.conf

MACHINEOVERRIDES = "extend-qemux86-64:qemux86-64"

PREFERRED_PROVIDER_virtual/kernel ?= "linux-yocto"
PREFERRED_VERSION_linux-yocto ?= "5.19%"
```
